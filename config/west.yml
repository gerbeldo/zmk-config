## config/west.yml
```yaml
manifest:
  remotes:
    - name: zmkfirmware
      url-base: https://github.com/zmkfirmware
    - name: gerbeldo
      url-base: https://github.com/gerbeldo

  projects:
    - name: zmk
      remote: zmkfirmware
      import: app/west.yml
      revision: main
      clone-depth: 1
    - name: flake-zmk-module
      remote: gerbeldo
      revision: main

  self:
    path: config
```
